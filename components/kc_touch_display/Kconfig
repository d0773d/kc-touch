## components/kc_touch_display/Kconfig
```kconfig
menu "KC Touch Display"

config KC_TOUCH_DISPLAY_ENABLE
    bool "Enable KC Touch display driver"
    default n
    help
        Enable the KC Touch display component used by the YamUI LVGL runtime.

if KC_TOUCH_DISPLAY_ENABLE

config KC_TOUCH_DISPLAY_BACKEND_WAVESHARE_P4
    bool "Waveshare ESP32-P4 module dev kit"
    default y
    help
        Use the Waveshare ESP32-P4 display backend.

config KC_TOUCH_DISPLAY_WIDTH
    int "Display width (pixels)"
    default 800
    range 100 2000

config KC_TOUCH_DISPLAY_HEIGHT
    int "Display height (pixels)"
    default 1280
    range 100 2000

config KC_TOUCH_WAVESHARE_LCD_RST_GPIO
    int "Waveshare LCD reset GPIO"
    default 27
    range -1 48
    help
        GPIO used for JD9365 reset. Set to -1 if reset pin is not connected.

config KC_TOUCH_WAVESHARE_BACKLIGHT_GPIO
    int "Waveshare backlight GPIO"
    default 26
    range -1 48
    help
        GPIO used to control panel backlight. Set to -1 if handled elsewhere.

config KC_TOUCH_WAVESHARE_MIPI_LDO_CHANNEL
    int "Waveshare MIPI LDO channel"
    default 3
    range 0 7
    help
        LDO channel used to power MIPI DSI PHY.

config KC_TOUCH_WAVESHARE_MIPI_LDO_MV
    int "Waveshare MIPI LDO voltage (mV)"
    default 2500
    range 1800 3300
    help
        Voltage for the selected MIPI PHY LDO channel.

config KC_TOUCH_DISPLAY_BUFFER_LINES
    int "LVGL buffer height (lines)"
    default 40
    range 10 160

choice KC_TOUCH_DISPLAY_ROTATION
    prompt "Display rotation"
    default KC_TOUCH_DISPLAY_ROTATION_0

config KC_TOUCH_DISPLAY_ROTATION_0
    bool "0 degrees"
config KC_TOUCH_DISPLAY_ROTATION_90
    bool "90 degrees"
config KC_TOUCH_DISPLAY_ROTATION_180
    bool "180 degrees"
config KC_TOUCH_DISPLAY_ROTATION_270
    bool "270 degrees"
endchoice

config KC_TOUCH_TOUCH_ENABLE
    bool "Enable touch input"
    default y

endif # KC_TOUCH_DISPLAY_ENABLE

endmenu
```

## components/kc_touch_gui/Kconfig
```kconfig
menu "KC Touch GUI"

config KC_TOUCH_GUI_ENABLE
    bool "Enable LVGL GUI subsystem"
    default y
    help
        Enable the KC Touch GUI subsystem powered by LVGL. Disable this option when
        the target does not need the GUI task or LVGL primitives.

if KC_TOUCH_GUI_ENABLE

config KC_TOUCH_GUI_TASK_STACK_SIZE
    int "GUI task stack size"
    default 8192
    range 4096 65536
    help
        Stack size (in bytes) used by the GUI FreeRTOS task. Increase when LVGL
        widgets allocate additional stack memory.

config KC_TOUCH_GUI_TASK_PRIORITY
    int "GUI task priority"
    default 5
    range 1 10
    help
        FreeRTOS priority assigned to the GUI task.

config KC_TOUCH_GUI_TASK_PERIOD_MS
    int "GUI task period (ms)"
    default 10
    range 1 100
    help
        Period at which the GUI task calls lv_timer_handler().

config KC_TOUCH_GUI_TICK_PERIOD_MS
    int "LVGL tick period (ms)"
    default 5
    range 1 10
    help
        Interval at which the LVGL tick timer increments internal timekeeping.

config KC_TOUCH_GUI_WORK_QUEUE_LENGTH
    int "GUI work queue depth"
    default 8
    range 2 32
    help
        Number of pending GUI work items (callbacks) that can be queued for the
        GUI task. Increase for complex scenes that schedule frequent updates.

config KC_TOUCH_GUI_CREATE_PLACEHOLDER_SCREEN
    bool "Create placeholder splash screen"
    default y
    help
        Automatically create a placeholder splash screen that confirms the LVGL
        core booted successfully. Disable when the final application provides its
        own startup scene.

endif # KC_TOUCH_GUI_ENABLE

endmenu
```

## components/lvgl_yaml_gui/Kconfig
```kconfig
menu "YamUI LVGL YAML GUI"

config YAMUI_NAV_QUEUE_MAX_DEPTH
    int "Navigation queue depth limit"
    default 16
    range 0 64
    help
        Maximum number of navigation requests the UI can defer while a render
        is in progress. Set to 0 to disable the guard and allow unbounded
        queuing (not recommended for memory-constrained targets).

endmenu
```

## components/sensor_manager/Kconfig
```kconfig
menu "Sensor Manager"

config SENSOR_MANAGER_ENABLE_FAKE_DATA
    bool "Enable simulated sensors when no hardware is detected"
    default y
    help
        Provide a small set of simulated Atlas Scientific EZO sensors when
        the runtime cannot discover any devices on the I2C bus. This keeps
        the YAML-driven UI usable on desktops and during CI without physical
        hardware. Disable this when running exclusively on production rigs.

config SENSOR_MANAGER_FORCE_FAKE_ONLY
    bool "Always use simulated sensors"
    depends on SENSOR_MANAGER_ENABLE_FAKE_DATA
    help
        Force the sensor manager to skip I2C probing entirely and rely solely
        on the built-in simulated dataset. This is useful for unit tests or
        UI development on devices without sensors attached.

endmenu
```

## components/yamui_loader/Kconfig
```kconfig
menu "YamUI Loader"

config YAMUI_LOADER_ENABLE
    bool "Enable YamUI dynamic loader"
    default y
    help
        Enable the YamUI loader subsystem that supports loading YAML schemas
        from LittleFS storage, UART upload, HTTPS download, and HTTP push.

if YAMUI_LOADER_ENABLE

config YAMUI_LOADER_STORAGE_MOUNT
    string "LittleFS mount point"
    default "/storage"
    help
        VFS mount point for the LittleFS partition used to persist uploaded
        or downloaded YAML schemas.

config YAMUI_LOADER_STORAGE_PARTITION
    string "LittleFS partition label"
    default "storage"
    help
        Label of the data partition in the partition table that will be
        formatted and mounted as LittleFS.

config YAMUI_LOADER_MAX_YAML_SIZE
    int "Maximum YAML payload size (bytes)"
    default 65536
    range 4096 262144
    help
        Upper limit on accepted YAML payloads via UART, HTTPS, or HTTP.
        Larger files will be rejected to protect limited RAM.

config YAMUI_LOADER_YAML_FILENAME
    string "Persisted YAML filename"
    default "ui.yml"
    help
        Filename (under the mount point) used to store the active YAML schema.

menu "UART Listener"

config YAMUI_LOADER_UART_ENABLE
    bool "Enable UART YAML listener"
    default y
    help
        Start a FreeRTOS task that listens for framed YAML uploads on a UART port.

config YAMUI_LOADER_UART_PORT
    int "UART port number"
    default 1
    range 0 2
    depends on YAMUI_LOADER_UART_ENABLE
    help
        UART peripheral to use for receiving YAML uploads.

config YAMUI_LOADER_UART_BAUD
    int "UART baud rate"
    default 115200
    depends on YAMUI_LOADER_UART_ENABLE

config YAMUI_LOADER_UART_TX_PIN
    int "UART TX GPIO pin"
    default 43
    depends on YAMUI_LOADER_UART_ENABLE

config YAMUI_LOADER_UART_RX_PIN
    int "UART RX GPIO pin"
    default 44
    depends on YAMUI_LOADER_UART_ENABLE

config YAMUI_LOADER_UART_TASK_STACK
    int "UART listener task stack size"
    default 4096
    range 2048 16384
    depends on YAMUI_LOADER_UART_ENABLE

config YAMUI_LOADER_UART_RX_TIMEOUT_S
    int "UART reception timeout (seconds)"
    default 30
    range 5 120
    depends on YAMUI_LOADER_UART_ENABLE

endmenu

menu "HTTPS Client"

config YAMUI_LOADER_HTTPS_ENABLE
    bool "Enable HTTPS YAML download"
    default n
    help
        Enable fetching YAML schemas from a remote HTTPS endpoint.

config YAMUI_LOADER_HTTPS_URL
    string "Default HTTPS URL"
    default ""
    depends on YAMUI_LOADER_HTTPS_ENABLE

config YAMUI_LOADER_HTTPS_POLL_INTERVAL_S
    int "HTTPS poll interval (seconds, 0 = one-shot)"
    default 0
    range 0 86400
    depends on YAMUI_LOADER_HTTPS_ENABLE

endmenu

menu "HTTP Server"

config YAMUI_LOADER_HTTPD_ENABLE
    bool "Enable HTTP server for WiFi push"
    default y
    help
        Start a lightweight HTTP server that accepts YAML uploads via POST
        and exposes device status via GET.

config YAMUI_LOADER_HTTPD_PORT
    int "HTTP server port"
    default 80
    range 1 65535
    depends on YAMUI_LOADER_HTTPD_ENABLE

endmenu

endif # YAMUI_LOADER_ENABLE

endmenu
```

## components/yui_camera/Kconfig
```kconfig
menu "YamUI Camera"

config YUI_CAMERA_ENABLE
    bool "Enable YamUI camera support"
    default n
    help
        Enables the board-facing camera initialization and generic frame stream
        helpers used by future YamUI camera widgets.

if YUI_CAMERA_ENABLE

choice YUI_CAMERA_INTERFACE
    prompt "Camera interface"
    default YUI_CAMERA_INTERFACE_DVP
    help
        Select the physical camera interface used by the attached sensor.

config YUI_CAMERA_INTERFACE_DVP
    bool "DVP"

config YUI_CAMERA_INTERFACE_MIPI_CSI
    bool "MIPI-CSI"

endchoice

config YUI_CAMERA_SCCB_I2C_PORT
    int "SCCB(I2C) port"
    default 0
    range 0 5

config YUI_CAMERA_SCCB_I2C_FREQ
    int "SCCB(I2C) frequency"
    default 100000
    range 10000 400000

config YUI_CAMERA_SCCB_SCL_PIN
    int "SCCB(I2C) SCL pin"
    default 8
    range -1 63

config YUI_CAMERA_SCCB_SDA_PIN
    int "SCCB(I2C) SDA pin"
    default 7
    range -1 63

config YUI_CAMERA_RESET_PIN
    int "Camera reset pin"
    default -1
    range -1 63

config YUI_CAMERA_PWDN_PIN
    int "Camera power-down pin"
    default -1
    range -1 63

if YUI_CAMERA_INTERFACE_DVP

config YUI_CAMERA_DVP_XCLK_FREQ
    int "DVP XCLK frequency"
    default 20000000
    range 1000000 40000000

config YUI_CAMERA_DVP_XCLK_PIN
    int "DVP XCLK pin"
    default 20
    range -1 63

config YUI_CAMERA_DVP_PCLK_PIN
    int "DVP PCLK pin"
    default 4
    range -1 63

config YUI_CAMERA_DVP_VSYNC_PIN
    int "DVP VSYNC pin"
    default 37
    range -1 63

config YUI_CAMERA_DVP_DE_PIN
    int "DVP DE pin"
    default 22
    range -1 63

config YUI_CAMERA_DVP_D0_PIN
    int "DVP D0 pin"
    default 2
    range -1 63

config YUI_CAMERA_DVP_D1_PIN
    int "DVP D1 pin"
    default 32
    range -1 63

config YUI_CAMERA_DVP_D2_PIN
    int "DVP D2 pin"
    default 33
    range -1 63

config YUI_CAMERA_DVP_D3_PIN
    int "DVP D3 pin"
    default 23
    range -1 63

config YUI_CAMERA_DVP_D4_PIN
    int "DVP D4 pin"
    default 3
    range -1 63

config YUI_CAMERA_DVP_D5_PIN
    int "DVP D5 pin"
    default 6
    range -1 63

config YUI_CAMERA_DVP_D6_PIN
    int "DVP D6 pin"
    default 5
    range -1 63

config YUI_CAMERA_DVP_D7_PIN
    int "DVP D7 pin"
    default 21
    range -1 63

endif # YUI_CAMERA_INTERFACE_DVP

if YUI_CAMERA_INTERFACE_MIPI_CSI

config YUI_CAMERA_MIPI_XCLK_PIN
    int "MIPI-CSI XCLK pin"
    default -1
    range -1 63

config YUI_CAMERA_MIPI_XCLK_FREQ
    int "MIPI-CSI XCLK frequency"
    default 24000000
    range 1000000 40000000

endif # YUI_CAMERA_INTERFACE_MIPI_CSI

endif # YUI_CAMERA_ENABLE

endmenu
```

## main/Kconfig.projbuild
```kconfig
menu "kc-touch Configuration"

    config KC_TOUCH_PROV_TRANSPORT_SOFTAP
        bool
        default y
        select LWIP_IPV4

    config KC_TOUCH_USE_SECURITY_VERSION_1
        bool
        default y
        select ESP_PROTOCOMM_SUPPORT_SECURITY_VERSION_1

    config KC_TOUCH_PROV_ENABLE_APP_CALLBACK
        bool "Enable provisioning manager app callback"
        default n
        help
            This is for advanced use-cases like modifying Wi-Fi configuration parameters. This
            executes a blocking app callback when any provisioning event is triggered.

    config KC_TOUCH_RESET_PROVISIONED
        bool
        default n
        prompt "Reset provisioned status of the device"
        help
            This erases the NVS to reset provisioned status of the device on every reboot.
            Provisioned status is determined by the Wi-Fi STA configuration, saved on the NVS.

    config KC_TOUCH_RESET_PROV_MGR_ON_FAILURE
        bool
        default y
        prompt "Reset provisioned credentials and state machine after session failure"
        help
            Enable resetting provisioned credentials and state machine after session failure.
            This will restart the provisioning service after retries are exhausted.

    config KC_TOUCH_PROV_MGR_CONNECTION_CNT
        int
        default 5
        prompt "Max connection attempts before resetting provisioning state machine"
        depends on KC_TOUCH_RESET_PROV_MGR_ON_FAILURE
        help
            Set the total number of connection attempts to avoid reconnecting to an inexistent AP or if credentials
            are misconfigured. Provisioned credentials are erased and internal state machine
            is reset after this threshold is reached.

    config KC_TOUCH_PROV_SHOW_QR
        bool "Show provisioning QR code"
        default y
        help
            Show the QR code for provisioning.

    config KC_TOUCH_REPROVISIONING
        bool "Re-provisioning"
        help
            Enable re-provisioning - allow the device to provision for new credentials
            after previous successful provisioning.

endmenu
```

## sdkconfig.defaults
```kconfig
# Waveshare ESP32-P4 + 10.1-DSI-TOUCH-A defaults
CONFIG_KC_TOUCH_DISPLAY_ENABLE=y
CONFIG_KC_TOUCH_DISPLAY_BACKEND_WAVESHARE_P4=y
CONFIG_KC_TOUCH_DISPLAY_WIDTH=800
CONFIG_KC_TOUCH_DISPLAY_HEIGHT=1280
CONFIG_KC_TOUCH_TOUCH_ENABLE=y
CONFIG_KC_TOUCH_DISPLAY_ROTATION_0=y
CONFIG_BSP_LCD_TYPE_800_1280_10_1_INCH_A=y

# Waveshare JD9365 defaults
CONFIG_KC_TOUCH_WAVESHARE_LCD_RST_GPIO=27
CONFIG_KC_TOUCH_WAVESHARE_BACKLIGHT_GPIO=26
CONFIG_KC_TOUCH_WAVESHARE_MIPI_LDO_CHANNEL=3
CONFIG_KC_TOUCH_WAVESHARE_MIPI_LDO_MV=2500

# YamUI/LVGL defaults
CONFIG_SENSOR_MANAGER_ENABLE_FAKE_DATA=y
CONFIG_YAMUI_NAV_QUEUE_MAX_DEPTH=16
CONFIG_LV_USE_QRCODE=y
CONFIG_LV_BUILD_EXAMPLES=n
CONFIG_LV_FONT_MONTSERRAT_20=y
CONFIG_LV_FONT_MONTSERRAT_28=y
CONFIG_LV_FONT_MONTSERRAT_48=y
CONFIG_LV_USE_CLIB_MALLOC=y
CONFIG_LV_USE_CLIB_STRING=y
CONFIG_LV_USE_CLIB_SPRINTF=y
CONFIG_YUI_CAMERA_ENABLE=y
CONFIG_YUI_CAMERA_INTERFACE_MIPI_CSI=y
CONFIG_YUI_CAMERA_SCCB_I2C_PORT=0
CONFIG_YUI_CAMERA_SCCB_I2C_FREQ=10000
CONFIG_YUI_CAMERA_SCCB_SCL_PIN=8
CONFIG_YUI_CAMERA_SCCB_SDA_PIN=7
CONFIG_YUI_CAMERA_RESET_PIN=-1
CONFIG_YUI_CAMERA_PWDN_PIN=-1
CONFIG_YUI_CAMERA_MIPI_XCLK_PIN=-1
CONFIG_YUI_CAMERA_MIPI_XCLK_FREQ=24000000
CONFIG_CAMERA_OV5647=y
CONFIG_CAMERA_OV5647_MIPI_RAW10_1920X1080_30FPS=y
CONFIG_CAMERA_OV5647_MIPI_IF_FORMAT_INDEX_DEFAULT=0
CONFIG_CAMERA_OV5647_DEFAULT_IPA_JSON_CONFIGURATION_FILE=y

# Memory/partition settings for ESP32-P4 app footprint
CONFIG_IDF_EXPERIMENTAL_FEATURES=y
CONFIG_SPIRAM=y
CONFIG_SPIRAM_USE_MALLOC=y
CONFIG_SPIRAM_MEMTEST=y
CONFIG_SPIRAM_MALLOC_ALWAYSINTERNAL=16384
CONFIG_SPIRAM_MALLOC_RESERVE_INTERNAL=32768
CONFIG_PARTITION_TABLE_CUSTOM=y
CONFIG_PARTITION_TABLE_CUSTOM_FILENAME="partitions.csv"
CONFIG_PARTITION_TABLE_FILENAME="partitions.csv"

# Build profile
CONFIG_COMPILER_OPTIMIZATION_SIZE=y
CONFIG_LOG_DEFAULT_LEVEL_INFO=y
CONFIG_ESP_SYSTEM_USE_FRAME_POINTER=y
# CONFIG_ESP_SYSTEM_NO_BACKTRACE is not set
CONFIG_LV_FONT_DEJAVU_16_PERSIAN_HEBREW=y
CONFIG_LV_FONT_DEFAULT_DEJAVU_16_PERSIAN_HEBREW=y
```
