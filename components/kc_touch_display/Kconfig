## sdkconfig.defaults.esp32s3
```kconfig
# ESP32-S3 target defaults
# Use this file alongside sdkconfig.defaults when building for ESP32-S3:
#   idf.py -D SDKCONFIG_DEFAULTS="sdkconfig.defaults;sdkconfig.defaults.esp32s3" set-target esp32s3

# Display — override P4-specific MIPI DSI settings
# CONFIG_KC_TOUCH_DISPLAY_BACKEND_WAVESHARE_P4 is not set

# Typical SPI LCD for ESP32-S3 dev boards (adjust per your hardware)
CONFIG_KC_TOUCH_DISPLAY_WIDTH=320
CONFIG_KC_TOUCH_DISPLAY_HEIGHT=240
CONFIG_KC_TOUCH_DISPLAY_ROTATION_0=y

# SPIRAM (PSRAM) — ESP32-S3 supports up to 16MB octal PSRAM
CONFIG_SPIRAM=y
CONFIG_SPIRAM_MODE_OCT=y
CONFIG_SPIRAM_USE_MALLOC=y
CONFIG_SPIRAM_MEMTEST=y
CONFIG_SPIRAM_MALLOC_ALWAYSINTERNAL=16384
CONFIG_SPIRAM_MALLOC_RESERVE_INTERNAL=32768

# Camera — disable MIPI CSI (S3 uses DVP or USB camera, not CSI)
# CONFIG_YUI_CAMERA_ENABLE is not set

# Partition table (same layout)
CONFIG_PARTITION_TABLE_CUSTOM=y
CONFIG_PARTITION_TABLE_CUSTOM_FILENAME="partitions.csv"
CONFIG_PARTITION_TABLE_FILENAME="partitions.csv"

# Build profile
CONFIG_COMPILER_OPTIMIZATION_SIZE=y
CONFIG_LOG_DEFAULT_LEVEL_INFO=y

# YamUI/LVGL
CONFIG_LV_USE_QRCODE=y
CONFIG_LV_BUILD_EXAMPLES=n
CONFIG_LV_FONT_MONTSERRAT_20=y
CONFIG_LV_FONT_MONTSERRAT_28=y
CONFIG_LV_USE_CLIB_MALLOC=y
CONFIG_LV_USE_CLIB_STRING=y
CONFIG_LV_USE_CLIB_SPRINTF=y

# YamUI Loader
CONFIG_YAMUI_LOADER_ENABLE=y
CONFIG_YAMUI_LOADER_UART_ENABLE=y
CONFIG_YAMUI_LOADER_HTTPD_ENABLE=y
```

## tests/test_navigation_stack/sdkconfig.defaults
```kconfig
# Keep standalone nav-queue test lightweight
CONFIG_KC_TOUCH_GUI_ENABLE=n
CONFIG_KC_TOUCH_DISPLAY_ENABLE=n
CONFIG_YAMUI_NAV_QUEUE_MAX_DEPTH=16
CONFIG_ESP_TASK_WDT_EN=n
CONFIG_ESP_CONSOLE_USB_SERIAL_JTAG=y
CONFIG_ESP_CONSOLE_SECONDARY_USB_SERIAL_JTAG=n
CONFIG_ESP_CONSOLE_USB_SERIAL_JTAG=y
CONFIG_ESP_CONSOLE_SECONDARY_USB_SERIAL_JTAG=n
```

## tests/test_sensor_manager/sdkconfig.defaults
```kconfig
# Run sensor_manager tests entirely on simulated data
CONFIG_SENSOR_MANAGER_ENABLE_FAKE_DATA=y
CONFIG_SENSOR_MANAGER_FORCE_FAKE_ONLY=y

# Speed up Unity test app boot
CONFIG_BOOTLOADER_SKIP_VALIDATE_ON_POWER_ON=y
CONFIG_COMPILER_OPTIMIZATION_SIZE=y
CONFIG_PARTITION_TABLE_SINGLE_APP=y
```
